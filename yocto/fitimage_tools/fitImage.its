## yocto/fitimage_tools/fitImage.its
```
/dts-v1/;

/ {
        description = "U-Boot fitImage for PetaLinux/5.4+gitAUTOINC+22b71b4162/microzed-zynq7";
        #address-cells = <1>;

        images {
                kernel@1 {
                        description = "Linux kernel";
                        data = /incbin/("linux.bin");
                        type = "kernel";
                        arch = "arm";
                        os = "linux";
                        compression = "none";
                        load = <0x8000>;
                        entry = <0x8000>;
                        hash@1 {
                                algo = "sha256";
                        };
                };
                fdt@system-top.dtb {
                        description = "Flattened Device Tree blob";
                        data = /incbin/("./system.dtb");
                        type = "flat_dt";
                        arch = "arm";
                        compression = "none";
                        
                        hash@1 {
                                algo = "sha256";
                        };
                };
	};

        configurations {
                default = "conf@system-top.dtb";
                conf@system-top.dtb {
			description = "1 Linux kernel, FDT blob";
			kernel = "kernel@1";
			fdt = "fdt@system-top.dtb";
			
			
                        hash@1 {
                                algo = "sha256";
                        };
                };
	};
};
```
